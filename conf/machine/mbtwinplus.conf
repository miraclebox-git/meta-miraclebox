## conf/machine/mbtwinplus.conf
```bitbake
#@TYPE: Machine
#@NAME: Miraclebox
#@DESCRIPTION: Machine configuration for the Miraclebox Premium Twin+

IMAGEDIR ?= "miraclebox/twinplus"

PREFERRED_VERSION_linux-${MACHINE} = "4.1.24"

MKUBIFS_ARGS = "-m 2048 -e 126976 -c 8192"
UBINIZE_ARGS = "-m 2048 -p 128KiB"

MACHINE_FEATURES += "dvb-c ci textlcd blindscan-dvbc videoenhancement"

CHIPSET = "bcm7241"
FORCE_REBOOT_OPTION = "reboot"

MACHINE_EXTRA_RDEPENDS += "enigma2-plugin-extensions-hbbtv-${MACHINE}"

require conf/machine/include/miraclebox.inc
```
